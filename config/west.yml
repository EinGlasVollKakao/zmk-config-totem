## config/west.yml
```yaml
manifest:
  remotes:
    - name: zmkfirmware
      url-base: https://github.com/zmkfirmware
    # Additional modules containing boards/shields/custom code can be listed here as well
    # See https://docs.zephyrproject.org/3.2.0/develop/west/manifest.html#projects
    - name: carrefinho                            # <-- display stuff
      url-base: https://github.com/EinGlasVollKakao     # <--
  projects:
    - name: zmk
      remote: zmkfirmware
      revision: main
      import: app/west.yml
    - name: prospector-zmk-module                 # <-- this too
      remote: carrefinho                          # <--
      revision: feat/new-status-screens           # <--
  self:
    path: config
```
